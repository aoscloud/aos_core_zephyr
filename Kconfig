## Kconfig
```kconfig
# Copyright (C) 2023 Renesas Electronics Corporation.
# Copyright (C) 2023 EPAM Systems, Inc.
#
# SPDX-License-Identifier: Apache-2.0


config DOMD_ID
	int "Dom D id"
	default 1

config SM_VCHAN_PATH
	string "Path to the SM vchan"
	default "/vchan/sm"

config CONNECTION_TIMEOUT_SEC
	int "Vchan connection timeout"
	default 5

config NODE_ID
	string "Node id"
	default "NODE_0"

config NODE_TYPE
	string "Nodde type"
	default "NODE_TYPE1"

config NUM_CPU
	int "Count of CPUs for domain with Zephyr"
	default 1

config TOTAL_RAM
	int "Total RAM of the domain"
	default 204800

config PARTITION_SIZE
	int "Partition size"
	default 209715200

source "Kconfig"
```

## west.yml
```yaml
#
# Copyright (C) 2023 Renesas Electronics Corporation.
# Copyright (C) 2023 EPAM Systems, Inc.
#
# SPDX-License-Identifier: Apache-2.0
#

# West YAML manifest for Zephyr as Xen Dom0

manifest:
  self:
    path: aos_core_zephyr

  remotes:
    - name: xen-troops
      url-base: https://github.com/xen-troops

    - name: aoscloud
      url-base: https://github.com/aoscloud

    - name: zephyrproject-rtos
      url-base: https://github.com/zephyrproject-rtos

  projects:
    - name: zephyr
      remote: xen-troops
      revision: aos-wip
      west-commands: scripts/west-commands.yml

    - name: aos_core_lib_cpp
      remote: aoscloud
      revision: develop

    - name: nanopb
      remote: zephyrproject-rtos
      revision: dc4deed54fd4c7e1935e3b6387eedf21bb45dc38
      path: modules/lib/nanopb
```
